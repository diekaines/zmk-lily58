## config/west.yml
```yaml
manifest:
  remotes:
    - name: zmkfirmware
      url-base: https://github.com/zmkfirmware
    - name: tanichangelcdtext
      url-base: https://github.com/diekaines/tanichangelcdtext	  
  projects:
    - name: zmk
      remote: tanichangelcdtext
      revision: main
      import: app/west.yml
  self:
    path: config
```
